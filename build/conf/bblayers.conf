## build/conf/bblayers.conf
```bitbake
# POKY_BBLAYERS_CONF_VERSION is increased each time build/conf/bblayers.conf
# changes incompatibly
POKY_BBLAYERS_CONF_VERSION = "2"

BBPATH = "${TOPDIR}"
BBFILES ?= ""

BBLAYERS ?= " \
  /home/smalinux/repos/yocto/poky/meta \
  /home/smalinux/repos/yocto/poky/meta-poky \
  /home/smalinux/repos/yocto/poky/meta-yocto-bsp \
  /home/smalinux/repos/yocto/meta-live \
  "
```

## meta-bsp-custom/conf/layer.conf
```bitbake
# We have a conf and classes directory, add to BBPATH
BBPATH .= ":${LAYERDIR}"

# We have recipes-* directories, add to BBFILES
BBFILES += "${LAYERDIR}/recipes-*/*/*.bb \
            ${LAYERDIR}/recipes-*/*/*.bbappend"

BBFILE_COLLECTIONS += "meta-bsp-custom"
BBFILE_PATTERN_meta-bsp-custom = "^${LAYERDIR}/"
BBFILE_PRIORITY_meta-bsp-custom = "6"

LAYERDEPENDS_meta-bsp-custom = "core"
LAYERSERIES_COMPAT_meta-bsp-custom = "kirkstone"
```

## meta-bsp-custom/conf/machine/wandboard-custom.conf
```bitbake
# SMA this file will overwrite:
# ./meta-freescale-3rdparty/conf/machine/wandboard.conf
require conf/machine/wandboard.conf

UBOOT_MACHINE = "wandboard-custom_defconfig"
KERNEL_DEVICETREE = "imx6qp-wandboard-custom-revd1.dtb"
```

## wandboard/conf/bblayers.conf
```bitbake
# POKY_BBLAYERS_CONF_VERSION is increased each time build/conf/bblayers.conf
# changes incompatibly
POKY_BBLAYERS_CONF_VERSION = "2"

BBPATH = "${TOPDIR}"
BBFILES ?= ""

BBLAYERS ?= " \
  /home/smalinux/repos/yocto/poky/meta \
  /home/smalinux/repos/yocto/poky/meta-poky \
  /home/smalinux/repos/yocto/meta-openembedded/meta-oe \
  /home/smalinux/repos/yocto/meta-openembedded/meta-multimedia \
  /home/smalinux/repos/yocto/meta-openembedded/meta-python \
  /home/smalinux/repos/yocto/meta-freescale \
  /home/smalinux/repos/yocto/meta-freescale-3rdparty \
  /home/smalinux/repos/yocto/meta-bsp-custom \
  "
```
