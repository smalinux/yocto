## build/bbb/conf/bblayers.conf
```bitbake
# POKY_BBLAYERS_CONF_VERSION is increased each time build/conf/bblayers.conf
# changes incompatibly
POKY_BBLAYERS_CONF_VERSION = "2"

BBPATH = "${TOPDIR}"
BBFILES ?= ""

BBLAYERS ?= " \
  /src/yocto/poky/meta \
  /src/yocto/poky/meta-poky \
  /src/yocto/poky/meta-yocto-bsp \
  /src/yocto/meta-arm/meta-arm \
  /src/yocto/meta-arm/meta-arm-toolchain \
  /src/yocto/meta-ti/meta-ti-bsp \
  /src/yocto/meta-ti/meta-ti-extras \
  /src/yocto/meta-openembedded/meta-oe \
  /src/yocto/meta-openembedded/meta-python \
  /src/yocto/meta-openembedded/meta-multimedia \
  /src/yocto/meta-rauc \
  /src/yocto/meta-rauc-bbb \
  /src/yocto/meta-bbb \
  /src/yocto/build/bbb/workspace \
  "
```

## meta-bbb/conf/machine/bbb.conf
```bitbake
#@TYPE: Machine
#@NAME: bbb
#@DESCRIPTION: Machine configuration for the Beaglebone (bbb)
# Reference: poky/meta-yocto-bsp/conf/machine/beaglebone-yocto.conf

PREFERRED_PROVIDER_virtual/xserver ?= "xserver-xorg"

MACHINE_EXTRA_RRECOMMENDS = "kernel-modules"

SOC_FAMILY = "ti335x"
TARGET_ARCH = "arm"

DEFAULTTUNE ?= "cortexa8hf-neon"
require conf/machine/include/arm/armv7a/tune-cortexa8.inc

PREFERRED_PROVIDER_virtual/kernel = "linux-stable"
KERNEL_IMAGETYPE = "zImage"

DTB_FILES = "am335x-bonegreen-wireless.dtb am335x-boneblue.dtb \
    am335x-bonegreen-wireless.dtb am335x-boneblack-wireless.dtb \
    am335x-boneblue.dtb am335x-pocketbeagle.dtb am335x-boneblack-wireless.dtb \
    bbb-gen4-4dcape70t.dtb am335x-boneblack.dtb bbb-gen4-4dcape70t.dtb \
    am335x-pocketbeagle.dtb am335x-bonegreen.dtb am335x-boneblack.dtb \
    am335x-bonegreen.dtb"

PREFERRED_PROVIDER_virtual/bootloader = "u-boot"
PREFERRED_PROVIDER_u-boot = "u-boot"
SPL_BINARY = "MLO"
UBOOT_SUFFIX = "img"
UBOOT_MACHINE = "am335x_evm_config"

EXTRA_IMAGEDEPENDS:append = " u-boot"
#EXTRA_IMAGEDEPENDS:append = " u-boot-scr"
EXTRA_IMAGEDEPENDS:append = " virtual/bootloader"

WKS_FILE ?= "core-image-bbb.wks"
do_image_wic[depends] += "mtools-native:do_populate_sysroot dosfstools-native:do_populate_sysroot virtual/bootloader:do_deploy"

SERIAL_CONSOLES ?= "115200;ttyS0 115200;ttyO0 115200;ttyAMA0"

IMAGE_FSTYPES:append = " tar.gz"
IMAGE_FSTYPES:append = " tar.xz"
IMAGE_FSTYPES:append = " jffs2"
IMAGE_FSTYPES:append = " wic.xz wic wic.bmap"
IMAGE_FSTYPES:append = " ext4"

MACHINE_ESSENTIAL_EXTRA_RDEPENDS = "kernel-image kernel-devicetree kernel-modules"

MACHINE_FEATURES += "ext2"
MACHINE_FEATURES += "serial"
MACHINE_FEATURES += "usbhost"
MACHINE_FEATURES += "vfat"
MACHINE_FEATURES += "usbgadget"
MACHINE_FEATURES += "alsa"

# change this to modify fdtfile in boot.scr
#KERNEL_DTB = "am335x-boneblack.dtb"

IMAGE_BOOT_FILES ?= "u-boot.${UBOOT_SUFFIX} ${SPL_BINARY} ${KERNEL_IMAGETYPE} ${DTB_FILES}"

#
# systemd
#
INIT_MANAGER = "systemd"
DISTRO_FEATURES:append = " systemd usrmerge"
VIRTUAL-RUNTIME_init_manager = "systemd"
DISTRO_FEATURES_BACKFILL_CONSIDERED += "sysvinit"
VIRTUAL-RUNTIME_initscripts = "systemd-compat-units"

#
# Rauc
# The only line you need to enable rauc outside of meta-rauc layer
# TODO: Move this to Disto file
# TODO: Read meta-rauc/README.rst
#
# HOWTO disable Rauc:
#   1. comment this line and remove meta-rauc-bbb bblayers.conf
#   2. remove meta-rauc-bbb from bblayers.conf
DISTRO_FEATURES:append = " rauc"

#
### support runqemu
# Ref: poky/meta-yocto-bsp/conf/machine/beaglebone-yocto.conf
#
EXTRA_IMAGEDEPENDS += "qemu-native qemu-helper-native"
IMAGE_CLASSES += "qemuboot"
QB_DEFAULT_FSTYPE = "wic"
QB_FSINFO = "wic:no-kernel-in-fs"
QB_KERNEL_ROOT = "/dev/vda2"
QB_SYSTEM_NAME = "qemu-system-arm"
QB_MACHINE = "-machine virt"
QB_CPU = "-cpu cortex-a15"
#QB_KERNEL_CMDLINE_APPEND = "console=ttyAMA0 systemd.mask=systemd-networkd"
QB_KERNEL_CMDLINE_APPEND = "console=ttyAMA0 init=/bin/sh"
QB_OPT_APPEND = "-device virtio-rng-device"
QB_TAP_OPT = "-netdev tap,id=net0,ifname=@TAP@,script=no,downscript=no"
QB_NETWORK_DEVICE = "-device virtio-net-device,netdev=net0,mac=@MAC@"
QB_ROOTFS_OPT = "-drive id=disk0,file=@ROOTFS@,if=none,format=raw -device virtio-blk-device,drive=disk0"
QB_SERIAL_OPT = ""
QB_TCPSERIAL_OPT = "-device virtio-serial-device -chardev socket,id=virtcon,port=@PORT@,host=127.0.0.1 -device virtconsole,chardev=virtcon"
```
